#include "lcd_display.h"
#include "wifi_creds.h"

#include <stdio.h>
#include <string.h>
#include <freertos/FreeRTOS.h>
#include <freertos/task.h>
#include <freertos/semphr.h>
#include <esp_log.h>
#include <esp_heap_caps.h>
#include <driver/gpio.h>
#include <driver/spi_master.h>
#include <esp_lcd_panel_io.h>
#include <esp_lcd_panel_vendor.h>
#include <esp_lcd_panel_ops.h>

static const char *TAG = "lcd_display";

#define LCD_H_RES 240
#define LCD_V_RES 135

#define LCD_PIN_SCLK 1
#define LCD_PIN_MOSI 2
#define LCD_PIN_DC   3
#define LCD_PIN_RST  4
#define LCD_PIN_CS   5
#define LCD_PIN_BL   6

// Color macro (RGB888 -> Byte-swapped RGB565 for SPI ST7789)
#define RGB565(r, g, b) (uint16_t)((((r) & 0xF8) << 8) | (((g) & 0xFC) << 3) | ((b) >> 3))
#define COLOR_SWAP(c)   (uint16_t)(((c) >> 8) | ((c) << 8))
#define COLOR(r, g, b)  COLOR_SWAP(RGB565(r, g, b))

// Theme Palette
#define COLOR_BG          COLOR(15, 23, 42)    // Dark Navy
#define COLOR_HEADER_BG   COLOR(30, 41, 59)    // Slate Gray
#define COLOR_TEXT        COLOR(248, 250, 252) // Crisp Off-white
#define COLOR_SUBTEXT     COLOR(148, 163, 184) // Muted Slate
#define COLOR_GREEN       COLOR(34, 197, 94)   // Emerald Green
#define COLOR_RED         COLOR(239, 68, 68)   // Bright Red
#define COLOR_YELLOW      COLOR(234, 179, 8)   // Warm Amber
#define COLOR_CYAN        COLOR(56, 189, 248)  // Sky Blue
#define COLOR_CARD_ON     COLOR(20, 83, 45)    // Dark Green Card
#define COLOR_CARD_OFF    COLOR(127, 29, 29)   // Dark Red Card
#define COLOR_CARD_BOOT   COLOR(113, 63, 18)   // Dark Amber Card
#define COLOR_BORDER      COLOR(51, 65, 85)    // Border Gray

#define LCD_BACKLIGHT_OFF_TIMEOUT_MS (5 * 60 * 1000) // 5 minutes

static esp_lcd_panel_handle_t s_panel_handle = NULL;
static uint16_t *s_fb = NULL;
static SemaphoreHandle_t s_lcd_mutex = NULL;

static lcd_wifi_status_t s_wifi_status = WIFI_STATUS_CONNECTING;
static char s_ip_address[32] = "0.0.0.0";
static lcd_pc_status_t s_pc_status = PC_STATUS_OFF;
static char s_message_line[64] = "Initializing...";

static bool s_backlight_on = true;
static bool s_manual_off = false;
static TickType_t s_off_start_tick = 0;
static bool s_colon_visible = true;


// 8x16 Basic ASCII Font Data (Characters 32..126)
static const uint8_t font8x16[95][16] = {
    {0x00,0x00,0x00,0x00,0x00,0x00,0x00,0x00,0x00,0x00,0x00,0x00,0x00,0x00,0x00,0x00}, // 32 ' '
    {0x00,0x00,0x18,0x3C,0x3C,0x3C,0x18,0x18,0x18,0x00,0x18,0x18,0x00,0x00,0x00,0x00}, // 33 '!'
    {0x00,0x66,0x66,0x66,0x24,0x00,0x00,0x00,0x00,0x00,0x00,0x00,0x00,0x00,0x00,0x00}, // 34 '"'
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    {0x00,0x3B,0x6E,0x00,0x00,0x00,0x00,0x00,0x00,0x00,0x00,0x00,0x00,0x00,0x00,0x00}  // 126 '~'
};

// Graphics Primitives
static void fb_fill_rect(int x, int y, int w, int h, uint16_t color) {
    if (x >= LCD_H_RES || y >= LCD_V_RES || w <= 0 || h <= 0) return;
    int x2 = x + w;
    int y2 = y + h;
    if (x < 0) x = 0;
    if (y < 0) y = 0;
    if (x2 > LCD_H_RES) x2 = LCD_H_RES;
    if (y2 > LCD_V_RES) y2 = LCD_V_RES;

    for (int py = y; py < y2; py++) {
        uint16_t *row = &s_fb[py * LCD_H_RES + x];
        for (int px = 0; px < (x2 - x); px++) {
            row[px] = color;
        }
    }
}

static void fb_fill_screen(uint16_t color) {
    fb_fill_rect(0, 0, LCD_H_RES, LCD_V_RES, color);
}

static void fb_draw_char(int x, int y, char c, uint16_t color, uint16_t bg, int scale) {
    if (c < 32 || c > 126) c = '?';
    const uint8_t *bmp = font8x16[c - 32];

    for (int row = 0; row < 16; row++) {
        uint8_t line = bmp[row];
        for (int col = 0; col < 8; col++) {
            bool pixel = (line & (0x80 >> col)) != 0;
            uint16_t pcolor = pixel ? color : bg;
            if (bg == 0xFFFF && !pixel) continue; // Transparent BG

            if (scale == 1) {
                int px = x + col;
                int py = y + row;
                if (px >= 0 && px < LCD_H_RES && py >= 0 && py < LCD_V_RES) {
                    s_fb[py * LCD_H_RES + px] = pcolor;
                }
            } else {
                fb_fill_rect(x + col * scale, y + row * scale, scale, scale, pcolor);
            }
        }
    }
}

static void fb_draw_string(int x, int y, const char *str, uint16_t color, uint16_t bg, int scale) {
    int cur_x = x;
    while (*str) {
        fb_draw_char(cur_x, y, *str, color, bg, scale);
        cur_x += 8 * scale;
        str++;
    }
}

static void set_display_power_state(bool enable) {
    if (s_backlight_on == enable) return;
    s_backlight_on = enable;
    gpio_set_level((gpio_num_t)LCD_PIN_BL, enable ? 1 : 0);
    if (s_panel_handle) {
        esp_lcd_panel_disp_on_off(s_panel_handle, enable);
    }
    ESP_LOGI(TAG, "LCD Power state -> %s (Backlight & ST7789 Display %s)",
             enable ? "ON" : "OFF", enable ? "Active" : "Sleep");
}

static void render_screen(void) {
    if (!s_fb || !s_panel_handle) return;
    if (!s_backlight_on) return; // Skip rendering & SPI DMA transfers when display is off

    // 1. Fill Background
    fb_fill_screen(COLOR_BG);


    // 2. Header Bar
    fb_fill_rect(0, 0, LCD_H_RES, 24, COLOR_HEADER_BG);
    fb_draw_string(6, 4, "SmartOnOff PC", COLOR_TEXT, COLOR_HEADER_BG, 1);
    fb_fill_rect(0, 24, LCD_H_RES, 1, COLOR_BORDER);

    // Header Right Badge: WiFi / Matter Status
    if (s_wifi_status == WIFI_STATUS_CONNECTING) {
        fb_fill_rect(130, 4, 104, 16, COLOR(161, 98, 7)); // Amber Badge
        fb_draw_string(136, 4, "Connecting", COLOR_TEXT, COLOR(161, 98, 7), 1);
    } else if (s_wifi_status == WIFI_STATUS_CONNECTED) {
        fb_fill_rect(145, 4, 89, 16, COLOR_CARD_ON); // Green Badge
        fb_draw_string(153, 4, "WiFi: OK", COLOR_TEXT, COLOR_CARD_ON, 1);
    } else {
        fb_fill_rect(135, 4, 99, 16, COLOR_CARD_OFF); // Red Badge
        fb_draw_string(143, 4, "Offline", COLOR_TEXT, COLOR_CARD_OFF, 1);
    }

    // 3. Middle Section: PC Status Card
    int card_y = 30;
    int card_h = 62;
    uint16_t card_bg = COLOR_CARD_OFF;
    const char *state_text = "OFF";
    uint16_t status_color = COLOR_RED;

    if (s_pc_status == PC_STATUS_ON) {
        card_bg = COLOR_CARD_ON;
        state_text = "ON";
        status_color = COLOR_GREEN;
    } else if (s_pc_status == PC_STATUS_BOOTING) {
        card_bg = COLOR_CARD_BOOT;
        state_text = "BOOTING";
        status_color = COLOR_YELLOW;
    }

    char status_str[32];
    snprintf(status_str, sizeof(status_str), "%s%c %s", PC_HOSTNAME,s_colon_visible ? ':' : ' ', state_text);

    // Draw PC State Card Container
    fb_fill_rect(6, card_y, LCD_H_RES - 12, card_h, card_bg);
    // Card Inner Accent Line
    fb_fill_rect(6, card_y, 4, card_h, status_color);

    // Large State Text (scale 2 = 16x32 per char)
    fb_draw_string(20, card_y + 10, status_str, COLOR_TEXT, card_bg, 2);

    // IP Address Info Line inside Card / Below Status
    char ip_line[40];
    snprintf(ip_line, sizeof(ip_line), "IP: %s", s_ip_address);
    fb_draw_string(20, card_y + 42, ip_line, COLOR_SUBTEXT, card_bg, 1);

    // 4. Bottom Footer / Event Message Line
    fb_fill_rect(0, 96, LCD_H_RES, 1, COLOR_BORDER);
    fb_draw_string(6, 102, "STATUS:", COLOR_CYAN, COLOR_BG, 1);

    // Truncate message if longer than ~21 chars to prevent overflow
    char msg_buf[25];
    snprintf(msg_buf, sizeof(msg_buf), "%.21s", s_message_line);
    fb_draw_string(66, 102, msg_buf, COLOR_TEXT, COLOR_BG, 1);

    // Subtitle / Matter protocol info
    fb_draw_string(6, 120, "Matter over Wi-Fi", COLOR_SUBTEXT, COLOR_BG, 1);

    // Flush Frame Buffer to ST7789 via SPI DMA
    esp_lcd_panel_draw_bitmap(s_panel_handle, 0, 0, LCD_H_RES, LCD_V_RES, s_fb);
}

static void lcd_blink_task(void *arg) {
    while (true) {
        vTaskDelay(pdMS_TO_TICKS(1000));
        if (s_lcd_mutex && s_backlight_on) {
            xSemaphoreTake(s_lcd_mutex, portMAX_DELAY);
            s_colon_visible = !s_colon_visible;
            render_screen();
            xSemaphoreGive(s_lcd_mutex);
        }
    }
}

esp_err_t lcd_display_init(void) {
    ESP_LOGI(TAG, "Initializing ST7789 LCD for Waveshare ESP32-C6-GEEK...");

    s_lcd_mutex = xSemaphoreCreateMutex();
    if (!s_lcd_mutex) {
        ESP_LOGE(TAG, "Failed to create LCD mutex");
        return ESP_ERR_NO_MEM;
    }

    // Allocate Framebuffer (240 * 135 * 2 bytes = ~64.8KB)
    s_fb = (uint16_t *)heap_caps_malloc(LCD_H_RES * LCD_V_RES * sizeof(uint16_t), MALLOC_CAP_DMA | MALLOC_CAP_INTERNAL);
    if (!s_fb) {
        s_fb = (uint16_t *)malloc(LCD_H_RES * LCD_V_RES * sizeof(uint16_t));
    }
    if (!s_fb) {
        ESP_LOGE(TAG, "Failed to allocate memory for LCD frame buffer");
        return ESP_ERR_NO_MEM;
    }

    // 1. SPI Bus Configuration
    spi_bus_config_t buscfg = {};
    buscfg.sclk_io_num = LCD_PIN_SCLK;
    buscfg.mosi_io_num = LCD_PIN_MOSI;
    buscfg.miso_io_num = -1;
    buscfg.quadwp_io_num = -1;
    buscfg.quadhd_io_num = -1;
    buscfg.max_transfer_sz = LCD_H_RES * LCD_V_RES * sizeof(uint16_t);

    esp_err_t err = spi_bus_initialize(SPI2_HOST, &buscfg, SPI_DMA_CH_AUTO);
    if (err != ESP_OK) {
        ESP_LOGE(TAG, "Failed to initialize SPI bus: %d", err);
        return err;
    }

    // 2. SPI Panel IO Setup
    esp_lcd_panel_io_spi_config_t io_config = {};
    io_config.dc_gpio_num = LCD_PIN_DC;
    io_config.cs_gpio_num = LCD_PIN_CS;
    io_config.pclk_hz = 40 * 1000 * 1000;
    io_config.lcd_cmd_bits = 8;
    io_config.lcd_param_bits = 8;
    io_config.spi_mode = 0;
    io_config.trans_queue_depth = 10;

    esp_lcd_panel_io_handle_t io_handle = NULL;
    err = esp_lcd_new_panel_io_spi((esp_lcd_spi_bus_handle_t)SPI2_HOST, &io_config, &io_handle);
    if (err != ESP_OK) {
        ESP_LOGE(TAG, "Failed to create LCD panel IO: %d", err);
        return err;
    }

    // 3. ST7789 Driver Panel Setup
    esp_lcd_panel_dev_config_t panel_config = {};
    panel_config.reset_gpio_num = LCD_PIN_RST;
    panel_config.rgb_endian = LCD_RGB_ENDIAN_BGR;
    panel_config.bits_per_pixel = 16;

    err = esp_lcd_new_panel_st7789(io_handle, &panel_config, &s_panel_handle);
    if (err != ESP_OK) {
        ESP_LOGE(TAG, "Failed to create ST7789 panel: %d", err);
        return err;
    }

    esp_lcd_panel_reset(s_panel_handle);
    esp_lcd_panel_init(s_panel_handle);
    esp_lcd_panel_invert_color(s_panel_handle, true);

    // Configure ST7789 240x135 Landscape rotation & offsets
    esp_lcd_panel_swap_xy(s_panel_handle, true);
    esp_lcd_panel_mirror(s_panel_handle, true, false);
    esp_lcd_panel_set_gap(s_panel_handle, 40, 53);
    esp_lcd_panel_disp_on_off(s_panel_handle, true);

    // 4. Backlight Control (GPIO 6 HIGH)
    gpio_config_t bk_gpio_config = {};
    bk_gpio_config.mode = GPIO_MODE_OUTPUT;
    bk_gpio_config.pin_bit_mask = 1ULL << LCD_PIN_BL;
    gpio_config(&bk_gpio_config);
    gpio_set_level((gpio_num_t)LCD_PIN_BL, 1);

    // Render Initial Splash Screen
    xSemaphoreTake(s_lcd_mutex, portMAX_DELAY);
    render_screen();
    xSemaphoreGive(s_lcd_mutex);

    xTaskCreate(lcd_blink_task, "lcd_blink", 3072, NULL, 2, NULL);

    ESP_LOGI(TAG, "LCD Display initialized successfully!");
    return ESP_OK;
}

void lcd_display_update_wifi(lcd_wifi_status_t status, const char *ip_str) {
    if (!s_lcd_mutex) return;
    xSemaphoreTake(s_lcd_mutex, portMAX_DELAY);
    s_wifi_status = status;
    if (ip_str && strlen(ip_str) > 0) {
        snprintf(s_ip_address, sizeof(s_ip_address), "%s", ip_str);
    }
    render_screen();
    xSemaphoreGive(s_lcd_mutex);
}

void lcd_display_update_pc(lcd_pc_status_t status) {
    if (!s_lcd_mutex) return;
    xSemaphoreTake(s_lcd_mutex, portMAX_DELAY);

    bool status_changed = (s_pc_status != status);
    s_pc_status = status;
    if (status_changed) {
        s_colon_visible = true;
    }

    if (status == PC_STATUS_OFF) {
        if (status_changed || s_off_start_tick == 0) {
            s_off_start_tick = xTaskGetTickCount();
        } else if (s_backlight_on) {
            TickType_t elapsed_ticks = xTaskGetTickCount() - s_off_start_tick;
            if (pdTICKS_TO_MS(elapsed_ticks) >= LCD_BACKLIGHT_OFF_TIMEOUT_MS) {
                set_display_power_state(false);
            }
        }
    } else {
        // PC is ON or BOOTING
        s_off_start_tick = 0;
        if (status_changed) {
            s_manual_off = false;
        }
        if (!s_backlight_on && !s_manual_off) {
            set_display_power_state(true);
        }
    }

    render_screen();
    xSemaphoreGive(s_lcd_mutex);
}

void lcd_display_set_message(const char *msg) {
    if (!s_lcd_mutex || !msg) return;
    xSemaphoreTake(s_lcd_mutex, portMAX_DELAY);
    snprintf(s_message_line, sizeof(s_message_line), "%s", msg);
    render_screen();
    xSemaphoreGive(s_lcd_mutex);
}

void lcd_display_set_backlight(bool enable) {
    if (!s_lcd_mutex) return;
    xSemaphoreTake(s_lcd_mutex, portMAX_DELAY);
    s_manual_off = !enable;
    if (s_backlight_on != enable) {
        set_display_power_state(enable);
        if (enable) {
            render_screen();
        }
    }
    xSemaphoreGive(s_lcd_mutex);
}

bool lcd_display_toggle_backlight(void) {
    if (!s_lcd_mutex) return false;
    xSemaphoreTake(s_lcd_mutex, portMAX_DELAY);
    bool new_state = !s_backlight_on;
    s_manual_off = !new_state;
    set_display_power_state(new_state);
    if (new_state) {
        render_screen();
    }
    xSemaphoreGive(s_lcd_mutex);
    return new_state;
}


